## conf/layer.conf
```bitbake
# We have a conf and classes directory, add to BBPATH
BBPATH .= ":${LAYERDIR}"

# We have recipes-* directories, add to BBFILES
BBFILES += "${LAYERDIR}/recipes-*/*/*.bb \
            ${LAYERDIR}/recipes-*/*/*.bbappend"

BBFILE_COLLECTIONS += "meta-daapd"
BBFILE_PATTERN_meta-daapd = "^${LAYERDIR}/"
BBFILE_PRIORITY_meta-daapd = "6"

LAYERDEPENDS_meta-daapd = "core"
LAYERSERIES_COMPAT_meta-daapd = "warrior zeus"
```
